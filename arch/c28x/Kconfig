## arch/c28x/Kconfig
```kconfig
# SPDX-License-Identifier: Apache-2.0
# TI C28x DSP architecture Kconfig

if C28X

config ARCH
	default "c28x"

config NUM_IRQS
	int
	default 96
	help
	  Total number of IRQs supported by the PIE (Peripheral Interrupt
	  Expansion) controller on C2000 devices. The PIE supports 12 groups
	  of 8 interrupts each (96 total) multiplexed onto 12 CPU interrupt
	  lines (INT1-INT12).

config NUM_CPU_IRQS
	int
	default 16
	help
	  Number of CPU-level interrupt lines (INT1-INT12 + DLOGINT +
	  RTOSINT + NMI + reset = 16 total CPU vectors).

config GEN_ISR_TABLES
	default y

config GEN_IRQ_VECTOR_TABLE
	default n

config STACK_ALIGN_SIZE
	int
	default 2
	help
	  C28x stack pointer is word-addressed (16-bit word aligned).

config MAIN_STACK_SIZE
	default 2048

config ISR_STACK_SIZE
	default 2048

config IDLE_STACK_SIZE
	default 512

config SRAM_OFFSET
	hex
	default 0x0

endif # C28X
```

## boards/ti/launchxl_f28379d/Kconfig
```kconfig
# SPDX-License-Identifier: Apache-2.0

config BOARD_LAUNCHXL_F28379D
	select SOC_TI_F28379D
	select CPU_HAS_FPU
```

## boards/ti/launchxl_f28379d/Kconfig.defconfig
```kconfig
# SPDX-License-Identifier: Apache-2.0

if BOARD_LAUNCHXL_F28379D

config BOARD
	default "launchxl_f28379d"

# Default to SCIA for console (connected to FTDI USB-UART on LaunchPad)
config UART_CONSOLE
	default y

config CONSOLE
	default y

# Enable SCI/UART driver when console is used
config SERIAL
	default y if CONSOLE

endif # BOARD_LAUNCHXL_F28379D
```

## boards/ti/launchxl_f28379d/board.yml
```yaml
board:
  name: launchxl_f28379d
  full_name: "TI LAUNCHXL-F28379D Evaluation Kit"
  vendor: ti
  socs:
    - name: ti_f28379d
```

## boards/ti/launchxl_f28379d/launchxl_f28379d_defconfig
```kconfig
CONFIG_SOC_TI_F28379D=y
CONFIG_BOARD_LAUNCHXL_F28379D=y

# Console via SCIA (USB-UART via XDS110 on LaunchPad)
CONFIG_SERIAL=y
CONFIG_CONSOLE=y
CONFIG_UART_CONSOLE=y

# Minimal defaults for bring-up
CONFIG_MAIN_STACK_SIZE=2048
CONFIG_IDLE_STACK_SIZE=512
CONFIG_ISR_STACK_SIZE=2048
```

## boards/ti/lp_am263p/Kconfig.lp_am263p
```kconfig
# TI LP-AM263P LaunchPad
#
# Copyright (c) 2026
# SPDX-License-Identifier: Apache-2.0

config BOARD_LP_AM263P
	select SOC_AM263P4_R5F0_0 if BOARD_LP_AM263P_AM263P4_R5F0_0
```

## boards/ti/lp_am263p/board.yml
```yaml
board:
  name: lp_am263p
  full_name: TI LP-AM263P LaunchPad
  vendor: ti
  socs:
  - name: am263p4
```

## boards/ti/lp_am263p/lp_am263p_am263p4_r5f0_0_defconfig
```kconfig
# Copyright (c) 2026
# SPDX-License-Identifier: Apache-2.0

# Execute from RAM (loaded by debugger / SBL), not XIP
CONFIG_XIP=n

# Pin control (IOMUX pad config; pulls in PINCTRL_TI_AM263X)
CONFIG_PINCTRL=y

# Serial / console
CONFIG_SERIAL=y
CONFIG_UART_INTERRUPT_DRIVEN=y
CONFIG_CONSOLE=y
CONFIG_UART_CONSOLE=y

# Cortex-R5F memory protection
CONFIG_ARM_MPU=y

# GPIO (direct register access used for early LED bring-up on ControlCARD)
CONFIG_GPIO=y
```

## boards/ti/tmdscncd263p/Kconfig.tmdscncd263p
```kconfig
# TI TMDSCNCD263P AM263P ControlCARD
#
# Copyright (c) 2026
# SPDX-License-Identifier: Apache-2.0

config BOARD_TMDSCNCD263P
	select SOC_AM263P4_R5F0_0 if BOARD_TMDSCNCD263P_AM263P4_R5F0_0
```

## boards/ti/tmdscncd263p/board.yml
```yaml
board:
  name: tmdscncd263p
  full_name: TI TMDSCNCD263P AM263P ControlCARD
  vendor: ti
  socs:
  - name: am263p4
```

## boards/ti/tmdscncd263p/tmdscncd263p_am263p4_r5f0_0_defconfig
```kconfig
# Copyright (c) 2026
# SPDX-License-Identifier: Apache-2.0

# Execute from RAM (loaded by debugger / SBL over XDS110), not XIP
CONFIG_XIP=n

# Pin control (IOMUX pad config; pulls in PINCTRL_TI_AM263X)
CONFIG_PINCTRL=y

# Serial / console
CONFIG_SERIAL=y
CONFIG_UART_INTERRUPT_DRIVEN=y
CONFIG_CONSOLE=y
CONFIG_UART_CONSOLE=y

# Cortex-R5F memory protection
CONFIG_ARM_MPU=y

# GPIO (USER LEDs LD6/LD7 via ti,davinci-gpio + DT pinctrl)
CONFIG_GPIO=y
```

## drivers/pinctrl/Kconfig.ti_am263x
```kconfig
# Copyright (c) 2026
# SPDX-License-Identifier: Apache-2.0

config PINCTRL_TI_AM263X
	bool "TI AM263x pinctrl driver"
	default y
	depends on PINCTRL && SOC_SERIES_AM263X
	help
	  Enable the minimal TI AM263x pinctrl driver. Pads are configured by
	  writing the value from the devicetree pinmux property to the absolute
	  PADCONFIG register address encoded in that property.
```

## drivers/timer/Kconfig.ti_rti_timer
```kconfig
# Copyright (c) 2026
# SPDX-License-Identifier: Apache-2.0

config TI_RTI_TIMER
	bool "TI RTI system timer"
	default y
	depends on DT_HAS_TI_RTI_TIMER_ENABLED
	select TICKLESS_CAPABLE
	help
	  System clock driver using the TI RTI (Real Time Interrupt) timer,
	  used as the kernel tick source on AM263x / AM263Px R5F devices.
```

## dts/bindings/adc/ti,am263x-adc.yaml
```yaml
# Copyright (c) 2026
# SPDX-License-Identifier: Apache-2.0

description: TI AM263x / AM263Px ADC (Type 4 SAR, CONTROLSS)

compatible: "ti,am263x-adc"

include:
  - name: adc-controller.yaml
  - name: pinctrl-device.yaml

properties:
  reg:
    required: true
    type: array
    description: |
      ADC config register base followed by result register base.
      Example for ADC0:
        reg = <0x502C0000 0x1000>, <0x50100000 0x1000>;

  interrupts:
    required: false
    description: |
      VIM interrupt(s). Optional for polling / software-triggered use.

  "#io-channel-cells":
    const: 1

io-channel-cells:
  - input
```

## dts/bindings/pinctrl/ti,am263x-pinctrl.yaml
```yaml
# Copyright (c) 2026
# SPDX-License-Identifier: Apache-2.0

description: |
  TI AM263x pin controller (IOMUX PADCONFIG block).

  Pads are configured by child nodes, each carrying a single
  <padconfig-register-address  value> pair in its "pinmux" property. The
  AM263x pinctrl driver (drivers/pinctrl/pinctrl_ti_am263x.c) writes that
  value verbatim to the absolute PADCONFIG register, so the controller itself
  needs no per-pin addressing.

compatible: "ti,am263x-pinctrl"

include: [base.yaml]

child-binding:
  description: AM263x single-pad configuration.
  properties:
    pinmux:
      type: array
      required: true
      description: |
        Two cells: [0] = absolute PADCONFIG register address, [1] = value to
        write (mux mode + pad attributes). Addresses are from datasheet
        SPRSP81 Table 5-1; mux mode 7 selects GPIO, mode 0 selects the pad's
        primary (named) function.
```

## dts/bindings/pwm/ti,am263x-epwm.yaml
```yaml
description: TI AM263x / AM263Px ePWM (Enhanced PWM) controller

compatible: "ti,am263x-epwm"

include:
  - name: pwm-controller.yaml
  - name: pinctrl-device.yaml

properties:
  reg:
    required: true
    type: array
    description: |
      MMIO register space.

  "#pwm-cells":
    const: 3

pwm-cells:
  - channel
  - period
  - flags
```

## dts/bindings/timer/ti,rti-timer.yaml
```yaml
# Copyright (c) 2026
# SPDX-License-Identifier: Apache-2.0

description: |
  TI RTI (Real Time Interrupt) timer used as the Zephyr system clock on
  AM263x / AM263Px Cortex-R5F devices. The RTI provides free-running
  up-counters (counter 0/1) with compare registers; compare 0 is used to
  generate the kernel tick.

compatible: "ti,rti-timer"

include: base.yaml

properties:
  reg:
    required: true

  interrupts:
    required: true
```

## soc/ti/am263x/Kconfig.defconfig
```kconfig
# Copyright (c) 2026
# SPDX-License-Identifier: Apache-2.0

if SOC_SERIES_AM263X

config KERNEL_ENTRY
	default "_vector_table" if SOC_SERIES_AM263X_R5

config NUM_IRQS
	# AM263x VIM. Matches the value used by the other TI R5F (am64x) ports;
	# refine against the AM263Px TRM (SPRUJ55) VIM interrupt map if needed.
	default 256 if SOC_SERIES_AM263X_R5

config SYS_CLOCK_HW_CYCLES_PER_SEC
	# RTI counter (FRC0) input clock (FCLK) = 100 MHz on the TMDSCNCD263P ControlCARD.
	# Measured directly (wall-clock stopwatch vs k_uptime_get()): the FRC runs at
	# half the 200 MHz the GEL and TRM describe for the documented path.
	#
	# GEL (C:\ti\...\AM263Px_PLL\AM263Px_Periheral_Clocks.gel:Program_RTI0_Clocks):
	#   MSS_RCM_RTI0_CLK_SRC_SEL = 0x222; _DIV_VAL = 0x000; prints "RTI0 Clock Enabled (200MHz)".
	#   Top-level GEL forces 400 MHz R5 / 200 MHz SYS_CLK (TOP_RCM 0x222 + DIVBY2 0x111).
	# TRM SPRUJ55 §6.4.8.2.1: 0x222 "selects SYS_CLK" for RTI FCLK (labeled FREQ=200 MHz),
	#   DIV=0x000; Table 4-56 shows FCLK (to counters) selectable from SYS_CLK 200 MHz
	#   (vs separate ICLK 200 MHz and other sources like XTAL 25 MHz / EXT_REFCLK 100 MHz).
	# Our soc.c:am263p_enable_rti_clock() does the identical writes (for GEL-less boots).
	# Result: the documented 200 MHz path is active, but effective FCLK to FRC0 is 100 MHz
	# on this board (SYS_CLK tap seen by MSS_RCM RTI mux or downstream FCLK path is half).
	# 100 MHz value is required for wall time; see CLAUDE.md "Verified clock / RTI facts"
	# and ROADMAP.md 2026-06-02 changelog entry for full citations + measurement data.
	default 100000000 if SOC_SERIES_AM263X_R5

if SERIAL

config UART_NS16550
	default y

config UART_NS16550_TI_K3
	default y if SOC_SERIES_AM263X_R5

choice UART_NS16550_VARIANT
	default UART_NS16550_VARIANT_NS16750
endchoice

endif # SERIAL

config BUILD_OUTPUT_BIN
	default n if SOC_SERIES_AM263X_R5

endif # SOC_SERIES_AM263X
```

## soc/ti/am263x/Kconfig.soc
```kconfig
# Copyright (c) 2026
# SPDX-License-Identifier: Apache-2.0

config SOC_FAMILY_TI_AM263X
	bool

config SOC_FAMILY
	default "ti_am263x" if SOC_FAMILY_TI_AM263X

config SOC_SERIES_AM263X
	bool
	select SOC_FAMILY_TI_AM263X
	help
	  TI AM263x / AM263Px Sitara real-time MCU series (Cortex-R5F).

config SOC_SERIES_AM263X_R5
	bool
	select SOC_SERIES_AM263X
	help
	  AM263x R5F core series.

config SOC_AM263P4
	bool
	select SOC_SERIES_AM263X_R5
	help
	  TI AM263P4 — quad Cortex-R5F @ 400 MHz real-time MCU.

config SOC_AM263P4_R5F0_0
	bool
	select SOC_AM263P4
	help
	  AM263P4 R5F SubSystem 0, Core 0 (primary boot core).

config SOC_SERIES
	default "am263x" if SOC_SERIES_AM263X

config SOC
	default "am263p4" if SOC_AM263P4
```

## soc/ti/c2000/Kconfig.soc
```kconfig
# SPDX-License-Identifier: Apache-2.0
# TI C2000 F283xx SoC series (C28x DSP core)

config SOC_SERIES_TI_C2000_F283XX
	bool
	select C28X
	select CPU_HAS_FPU
	help
	  TI C2000 F283xx series (e.g. TMS320F28379D).
	  Dual-core C28x DSP with FPU, TMU, and PIE controller.
```

## soc/ti/c2000/Kconfig.soc.defconfig
```kconfig
# SPDX-License-Identifier: Apache-2.0
# TI C2000 SoC family top-level defconfig

if SOC_SERIES_TI_C2000_F283XX

config SOC_SERIES
	default "ti_c2000_f283xx"

endif # SOC_SERIES_TI_C2000_F283XX
```

## soc/ti/c2000/f28379d/Kconfig.defconfig
```kconfig
# SPDX-License-Identifier: Apache-2.0

if SOC_TI_F28379D

config SOC
	default "ti_f28379d"

config NUM_IRQS
	default 96   /* 12 PIE groups x 8 lines */

config SYS_CLOCK_HW_CYCLES_PER_SEC
	default 200000000   /* 200 MHz SYSCLK */

config CORTEX_M_SYSTICK
	default n   /* C28x uses CPU Timer 0, not ARM SysTick */

config SYS_CLOCK_EXISTS
	default y

endif # SOC_TI_F28379D
```

## soc/ti/c2000/f28379d/Kconfig.soc
```kconfig
# SPDX-License-Identifier: Apache-2.0

config SOC_TI_F28379D
	bool
	select SOC_SERIES_TI_C2000_F283XX
	help
	  TI TMS320F28379D dual-core C28x DSP.
	  CPU1 primary core: 200 MHz C28x + FPU + TMU.
	  512KB Flash, 204KB RAM, 12-group PIE interrupt controller.
```
