## CMakeLists.txt
```
# SPDX-License-Identifier: Apache-2.0

cmake_minimum_required(VERSION 3.20.0)

find_package(Zephyr REQUIRED HINTS $ENV{ZEPHYR_BASE})
project(am263_app)

target_include_directories(app PRIVATE src)

target_sources(app PRIVATE
  src/main.c
  src/framework/app.c
  src/framework/cmd_sys.c
)

target_sources_ifdef(CONFIG_AM263_APP_BLINK app PRIVATE
  src/apps/blink/app_blink.c
  src/apps/blink/task_blink.c
  src/apps/blink/cmd_blink.c
)
```

## Kconfig
```
# AM263P in-tree application skeleton (Layer-2 pattern).
#
# Copyright (c) 2026
# SPDX-License-Identifier: Apache-2.0

mainmenu "AM263P application"

menu "Applications"

config AM263_APP_BLINK
	bool "Blink app (LED task + 'blink' shell commands)"
	default y
	depends on GPIO
	help
	  LED blink background task plus its 'blink' shell command group.

endmenu

source "Kconfig.zephyr"
```

## prj.conf
```kconfig
# Phase 5 app skeleton: interactive shell on UART0 + GPIO for the blink task.
CONFIG_SHELL=y
CONFIG_GPIO=y

# Plain-text shell: this console terminal does not render VT100 escapes.
# Disabling VT100 commands also disables colors (Kconfig dependency) and the
# cursor-positioning codes ("\e[13C") used in help formatting.
CONFIG_SHELL_VT100_COMMANDS=n

# Name app/task threads so 'kernel threads' is readable.
CONFIG_THREAD_NAME=y
```

## src/main.c
```c
/*
 * Copyright (c) 2026
 *
 * SPDX-License-Identifier: Apache-2.0
 *
 * AM263P application skeleton (Phase 5).
 *
 * main() only brings up the platform: it starts the Kconfig-enabled apps and
 * returns. Everything interactive runs in the shell thread; periodic work runs
 * in each app's task thread. This is the in-tree seed of the AMDC-style
 * app_/task_/cmd_ layout, to be extracted to the out-of-tree Layer-2 workspace.
 */

#include <zephyr/kernel.h>

#include "framework/app.h"

int main(void)
{
	printk("\n*** AM263P application platform up (Phase 5) ***\n");
	printk("Build time: %s %s\n", __DATE__, __TIME__);
	printk("Try: 'help', 'am263 uptime', 'blink status', 'blink interval 1000'\n");

	apps_init();
	return 0;
}
```
